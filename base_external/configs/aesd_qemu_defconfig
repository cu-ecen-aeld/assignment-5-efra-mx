## base_external/configs/aesd_qemu_defconfig
```kconfig
BR2_TARGET_GENERIC_ROOT_PASSWD="root"
BR2_PACKAGE_DROPBEAR=y
BR2_TARGET_ROOTFS_CPIO=y
BR2_TARGET_ROOTFS_CPIO_GZIP=y
BR2_PACKAGE_AESD_ASSIGNMENTS=y
```
